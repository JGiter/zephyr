## tests/drivers/i2c/i2c_lsm6dsl/testcase.yaml
```yaml
common:
  tags:
    - drivers
    - i2c
  depends_on: i2c
tests:
  drivers.i2c.lsm6dsl:
    # filter: dt_compat_enabled("st,lsm6dsl")
    platform_allow:
      - xiao_ble/nrf52840/sense
```
